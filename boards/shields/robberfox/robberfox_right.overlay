#include "robberfox.overlay"

&chosen {
    zmk,kscan = &default_kscan;
    zmk,matrix-transform = &default_transform;
};

&default_transform {
    col-offset = <6>; // Shifts the right side matrix by 6 columns
};
