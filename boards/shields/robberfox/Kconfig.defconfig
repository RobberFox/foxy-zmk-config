## boards/shields/robberfox/Kconfig.shield
```kconfig
config SHIELD_ROBBERFOX_LEFT
    def_bool $(shields_list_contains,robberfox_left)

config SHIELD_ROBBERFOX_RIGHT
    def_bool $(shields_list_contains,robberfox_right)
```
